## Kernel/LXC/LXC_defconfig
```kconfig
CONFIG_MULTIUSER=y
CONFIG_IP6_NF_NAT=y
CONFIG_IP_NF_NAT=y
CONFIG_BPF=y
CONFIG_CGROUP_BPF=y
CONFIG_BPF_SYSCALL=y
CONFIG_CGROUP_PIDS=y
CONFIG_HUGETLB_PAGE=y
CONFIG_CGROUP_HUGETLB=y
CONFIG_CGROUP_NET_PRIO=y
CONFIG_!SCHED_WALT=y
CONFIG_IPVLAN=y
CONFIG_NET_L3_MASTER_DEV=y
CONFIG_AUFS_FS=y
CONFIG_OVERLAY_FS=y
CONFIG_USER_NS=y
```
